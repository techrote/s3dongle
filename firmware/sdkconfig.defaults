## firmware/sdkconfig.defaults
```kconfig
CONFIG_IDF_TARGET="esp32s3"
CONFIG_ESPTOOLPY_FLASHSIZE_4MB=y
CONFIG_BT_ENABLED=y
CONFIG_BT_CONTROLLER_ONLY=y
CONFIG_ESP_DEFAULT_CPU_FREQ_MHZ_240=y
CONFIG_FREERTOS_HZ=1000
CONFIG_TINYUSB_BTH_ENABLED=y
CONFIG_TINYUSB_BTH_ISO_ALT_COUNT=1
CONFIG_TINYUSB_CDC_ENABLED=n
CONFIG_TINYUSB_NET_MODE_NONE=y
CONFIG_TINYUSB_DESC_MANUFACTURER_STRING="techrote"
CONFIG_TINYUSB_DESC_PRODUCT_STRING="S3 BLE USB Dongle"
CONFIG_TINYUSB_DESC_SERIAL_STRING="1C2904BECC48"
CONFIG_ESP_CONSOLE_UART_DEFAULT=y
```
